## meta-evb-aspeed/meta-evb-ast2600/conf/machine/evb-ast2600-a1.conf
```bitbake
KERNEL_DEVICETREE = "aspeed-ast2600-evb.dtb"
UBOOT_MACHINE = "ast2600_openbmc_spl_defconfig"
UBOOT_DEVICETREE = "ast2600a1-evb"
SPL_BINARY = "spl/u-boot-spl.bin"

# MACHINE_FEATURES = ""

require conf/machine/include/ast2600.inc

# Overwrite flash offsets

FLASH_SIZE = "65536"
FLASH_UBOOT_OFFSET = "0"
FLASH_KERNEL_OFFSET = "1024"
FLASH_ROFS_OFFSET = "10240"
FLASH_RWFS_OFFSET = "43008"
```

## meta-evb-enclustra/meta-evb-zx3-pm3/conf/bblayers.conf.sample
```bitbake
# LAYER_CONF_VERSION is increased each time build/conf/bblayers.conf
# changes incompatibly
LCONF_VERSION = "6"

BBPATH = "${TOPDIR}"
BBFILES ?= ""

BBLAYERS ?= " \
  ##OEROOT##/meta \
  ##OEROOT##/meta-poky \
  ##OEROOT##/import-layers/meta-openembedded/meta-oe \
  ##OEROOT##/import-layers/meta-openembedded/meta-networking \
  ##OEROOT##/import-layers/meta-openembedded/meta-perl \
  ##OEROOT##/import-layers/meta-openembedded/meta-python \
  ##OEROOT##/import-layers/meta-openembedded/meta-webserver \
  ##OEROOT##/import-layers/meta-virtualization \
  ##OEROOT##/meta-phosphor \
  ##OEROOT##/meta-xilinx \
  ##OEROOT##/meta-xilinx/meta-zynq7 \
  ##OEROOT##/meta-xilinx/meta-zynq7/meta-mars-zx3 \
  ##OEROOT##/meta-evb \
  ##OEROOT##/meta-evb-enclustra \
  ##OEROOT##/meta-evb-enclustra/meta-evb-zx3-pm3 \
  "
BBLAYERS_NON_REMOVABLE ?= " \
  ##OEROOT##/meta \
  ##OEROOT##/meta-poky \
  ##OEROOT##/import-layers/meta-openembedded/meta-oe \
  ##OEROOT##/import-layers/meta-openembedded/meta-networking \
  ##OEROOT##/import-layers/meta-openembedded/meta-perl \
  ##OEROOT##/import-layers/meta-openembedded/meta-python \
  ##OEROOT##/import-layers/meta-openembedded/meta-webserver \
  ##OEROOT##/import-layers/meta-virtualization \
  ##OEROOT##/meta-phosphor \
  ##OEROOT##/meta-xilinx \
  ##OEROOT##/meta-xilinx/meta-zynq7 \
  ##OEROOT##/meta-xilinx/meta-zynq7/meta-mars-zx3 \
  ##OEROOT##/meta-evb \
  ##OEROOT##/meta-evb-enclustra \
  ##OEROOT##/meta-evb-enclustra/meta-evb-zx3-pm3 \
  "
```

## meta-evb-enclustra/meta-evb-zx3-pm3/conf/local.conf.sample
```bitbake
MACHINE ??= "evb-zx3-pm3"
DISTRO ?= "openbmc-phosphor"
PACKAGE_CLASSES ?= "package_rpm"
SANITY_TESTED_DISTROS_append ?= " *"
EXTRA_IMAGE_FEATURES = "debug-tweaks"
USER_CLASSES ?= "buildstats image-mklibs image-prelink"
PATCHRESOLVE = "noop"
BB_DISKMON_DIRS = "\
    STOPTASKS,${TMPDIR},1G,100K \
    STOPTASKS,${DL_DIR},1G,100K \
    STOPTASKS,${SSTATE_DIR},1G,100K \
    STOPTASKS,/tmp,100M,100K \
    ABORT,${TMPDIR},100M,1K \
    ABORT,${DL_DIR},100M,1K \
    ABORT,${SSTATE_DIR},100M,1K \
    ABORT,/tmp,10M,1K"
CONF_VERSION = "1"

# Set the root password to '0penBmc'
INHERIT += "extrausers"
EXTRA_USERS_PARAMS = " \
  usermod -p '\$1\$UGMqyqdG\$FZiylVFmRRfl9Z0Ue8G7e/' root; \
  "

# Xilinx specific variables
# These have to be set in order for everything to work!

# Device tree variables
#
# Since the Zynq chip has an FPGA, which can be programmed arbitrarily, the
# device tree cannot be given as a static file. Because of that a device tree
# generated from the hardware description is used. The device trees can be
# generated with Vivado or by a standalone tool provided by Xilinx.

# The location of the SDK project which contains the generated device tree.
# If the Vivado SDK was used to generate the device tree, this variable can be
# used to specify the SDK location (from which the device tree location will be
# inferred via as "$VIVADO_SDK_LOCATION/device_tree_bsp_0")
# Documentation on generating the device tree project can be found at
# http://www.wiki.xilinx.com/Build+Device+Tree+Blob
VIVADO_SDK_LOCATION = "~/workspace/Vivado_PM3/MarsZX3_PM3.sdk"

# Alternatively to VIVADO_SDK_LOCATION, the location of the generated device
# tree can be given directly.
# This is useful when generating the device tree directly as documented in
# http://www.wiki.xilinx.com/ZCU102%20Image%20creation%20in%20OSL%20flow#Build%20device-tree
# XILINX_GENERATED_DEVICE_TREE_PROJECT_LOCATION = ""
```

## meta-evb-enclustra/meta-evb-zx3-pm3/conf/machine/evb-zx3-pm3.conf
```bitbake
KMACHINE = "zynq"
KERNEL_DEVICETREE = "${KMACHINE}-mars-zx3.dtb"

UBOOT_MACHINE = "zynq_mars_zx3_defconfig"

require conf/machine/include/tune-zynq.inc
require conf/machine/include/machine-xilinx-default.inc
require conf/machine/include/obmc-bsp-common.inc

PREFERRED_PROVIDER_virtual/phosphor-led-manager-config-native = "evb-zx3-pm3-led-manager-config-native"
```

## meta-evb-raspberrypi/meta-evb-raspberrypi-cm3/conf/layer.conf
```bitbake
# We have a conf and classes directory, add to BBPATH
BBPATH .= ":${LAYERDIR}"

# We have a recipes directory, add to BBFILES
BBFILES += "${LAYERDIR}/recipes*/*/*.bb \
            ${LAYERDIR}/recipes*/*/*.bbappend \
            ${LAYERDIR}/images/*.bb"

BBFILE_COLLECTIONS += "evb-raspberrypi-cm3"
BBFILE_PATTERN_evb-raspberrypi-cm3 = ""
LAYERSERIES_COMPAT_evb-raspberrypi-cm3 = "sumo"
```
